
.INCLUDE "M644PDEF.INC"

JMP START

CHECK_BUTTON:
	PUSH R20
	PUSH	YH
	PUSH	YL
	IN R20, PIND
	ANDI R20, 0X08	// PRZYCISK 'PROGRAM' PODPIETY DO PD3
	BREQ PRESSET
	LDI R20, 0XFF	// ZWRACA 0XFF GDY ZWOLNIONY

PRESSET:
	ST Y+, R20	// POWROT Z ZEREM GDY WCISNIETY
	POP	YL
	POP	YH
	POP R20
	RET
	
  DELAY:
	  PUSH	R16	// SAVE REGISTERS
	  PUSH	R17
	  PUSH	R18
	  PUSH	R19
	  PUSH	YH
	  PUSH	YL
	  LDD	R17, Y+0	// 1ST. LOOP-PARAMETR	
	  DEC	YL
	  LDD	R18, Y+0	// 2ND. 
	  DEC	YL
	  LDD	R19, Y+0	// 3TH. 
	LOOP:
		NOP
		NOP
		NOP
		DEC	R17
		BRNE	LOOP
		DEC	R18
		BRNE	LOOP
		DEC	R19
		BRNE	LOOP
	  POP	YL
	  POP	YH
	  POP	R19
	  POP	R18
	  POP	R17
	  POP	R16
	  RET

//R26..R31 = X, Y, Z
FIBONACCI:
	PUSH R16 // SAVE REGISTERS
	PUSH R17
	PUSH R18
	PUSH R19
	PUSH YH
	PUSH YL
	LD R17, Y  // 1ST. PARAMETR
	LD R18, -Y // 2ND. PARAMETR
	LD R19, -Y // 3TH. PARAMETR


	ADD R17, R18	// R17: PREVIOUS1, R18: PREVIOUS2
	MOV R19, R18	// save the R18
	MOV R18, R17	
	MOV R17, R19	// exchange of R17 and R18

	EOR R19, R19	// R19 = 0 RETURNS ALLWAYS ZERO

	ST Y+, R19
	ST Y+, R18	// result in R18
	ST Y+, R17

	POP YL
	POP YH
	POP R19
	POP R18
	POP R17
	POP R16
	RET

START:
// INITIALIZATION
LDI R16, LOW(RAMEND) // STACK POINTER INITIALIZATION
OUT SPL, R16
MOV YL, R16 // SET OF REGISTER Y
LDI R16, HIGH(RAMEND)
OUT SPH, R16
MOV YH, R16

LDI R16, 0XFF	
OUT DDRB, R16	//output direction of PORTA
OUT PORTD, R16  // PULL-UP

INC R16
OUT DDRD, R16  // PORTD JAKO INPUT

BEGIN:
LDI R16, 0X0B  // licznik ciagu 
LDI R17, 0X00
LDI R18, 0X01
LDI R19, 0X00

LDI R21, 0XFF	// delay parameters
LDI R22, 0XFF
LDI R23, 0X40

LOOP2:
	PUSH R17 // 1ST. PARAMETR
	PUSH R18 // 2ND. PARAMETR
	PUSH R19 // 3TH. PARAMETR - not used here
	RCALL FIBONACCI
	POP R19
	POP R18	// RESULT IN R18
	POP R17 

	MOV R20, R18	
//	SWAP R20	// DLA MOJEGO UKLADU
	OUT PORTB, R20

	PUSH R24
	RCALL CHECK_BUTTON	// TO SPRAWDZANIE POWINNO BYC W PETLI OCZEKIWANIA (DELAY)
	POP R24
	CPI R24, 0XFF  // CZY ZWOLNIONY?
	BREQ ZWOLNIONY

	LDI R24, 0XFF
	OUT PORTB, R24

ZWOLNIONY:
	PUSH R21 // DELAY 1ST. PARAMETR
	PUSH R22 // DELAY 2ND. PARAMETR
	PUSH R23 // DELAY 3TH. PARAMETR
	RCALL DELAY
	POP R23
	POP R22	
	POP R21 

	DEC R16
	BRNE LOOP2

RJMP BEGIN
