
#include <avr/io.h>
#include <avr/interrupt.h>
#include <util/delay.h>
#include <stdlib.h>
#include "nokia_lcd.h"

int xRAM;
int yRAM;


int pos;
uint8_t *pcData;

static const char fonts[][5] =
{
	{ 0x00, 0x00, 0x00, 0x00, 0x00 },        // sp
	{ 0x00, 0x00, 0x2f, 0x00, 0x00 },        // !
	{ 0x00, 0x07, 0x00, 0x07, 0x00 },        // "
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	{ 0xFF, 0xFF, 0x7E, 0x3C, 0x18 },        // }

};

void Delay_MS(uint16_t dMS) {
	while (dMS--) {
		_delay_loop_2(2000);
	}
}


void Port_Init(void) {
	// DDRB |= (1 << PB0) | (1 << PB2) | (1 << PB3) | (1 << PB4) | (1 << PB5) | (1 << PB7);
	DDRA = 0xFF;
	DDRB = 0xFF;
	DDRC = 0x00;
	DDRL = 0xFF;
}

void SPI_MasterInit(void) {
	SPCR |= (1 << SPE) | (1 << MSTR);
	SPSR |= _BV(SPI2X);
}

uint8_t SPI_MasterTransmit(unsigned char cByte) {
	SPDR = cByte;
	while (!(SPSR & (1 << SPIF)))
	// czekaj az bajt przeslany
	;
	return SPDR;
}

void N5110_WriteByte(uint8_t cByte, uint8_t cCommand) {
	N5110_CE_CLR;
	if (cCommand == 0) {
		N5110_DC_CLR;
	}
	else {
		N5110_DC_SET;
	}
	SPI_MasterTransmit(cByte);
	N5110_CE_SET;
}

void N5110_Clear(void) {
	uint16_t i;

	N5110_WriteByte(0x80, 0);
	N5110_WriteByte(0x40, 0);
	N5110_WriteByte(0x80, 0);
	for (i = 0; i < 504; i++) {
		N5110_WriteByte(0x00, 1);
	}
}


void N5110_Init(void) {
	N5110_RST_CLR;
	asm("nop");
	asm("nop");
	//Delay_MS(1);
	N5110_RST_SET;
	N5110_CE_CLR;
	asm("nop");
	asm("nop");
	//Delay_MS(1);
	N5110_CE_SET;
	asm("nop");
	asm("nop");
	Delay_MS(1);
	N5110_WriteByte(0x21, 0);        // extended instruction set
	N5110_WriteByte(0xc3, 0);        // set VOP
	N5110_WriteByte(0x04, 0);        // set TCx (jak 4, 5, 7 to ekran czarny)
	N5110_WriteByte(0x13, 0);        // bias system 1:48 (tym sie reguluje contrast)
	N5110_WriteByte(0x20, 0);        // basic instruction set
	N5110_Clear();
	N5110_WriteByte(0x0C, 0);        // display control normal mode
	N5110_CE_CLR;

	N5110_BL_SET;        // wlacz podswietlenie
}

void setPos(int pos) {
	if (pos - 420 >= 0) {
		yRAM = 5;
		xRAM = pos - 420;
		} else if (pos - 336 >= 0) {
		yRAM = 4;
		xRAM = pos - 336;
		} else if (pos - 252 >= 0) {
		yRAM = 3;
		xRAM = pos - 252;
		} else if (pos - 168 >= 0) {
		yRAM = 2;
		xRAM = pos - 168;
		} else if (pos - 84 >= 0) {
		yRAM = 1;
		xRAM = pos - 84;
		} else {
		yRAM = 0;
		xRAM = pos;
	}

	N5110_WriteByte(((yRAM) | (1 << 6)), 0);        // Y-bank
	N5110_WriteByte(((xRAM) | (1 << 7)), 0);        // X
}

void printChar(char ch) {
	char litera;
	uint8_t i;

	for (i = 0; i < 5; i++) {
		litera = fonts[ch - 0x20][i];
		N5110_WriteByte(litera, 1);
	}
	N5110_WriteByte(0x00, 1);        // maly odstep
}

void printWord(char *bString) {
	char ch;
	while (*bString) {
		ch = *bString++;
		printChar(ch);
	}
}

void N5110_RefreshRam(uint8_t *pcBuff) {
	uint16_t i;
	N5110_WriteByte(0x80, 0);
	N5110_WriteByte(0x40, 0);
	N5110_WriteByte(0x80, 0);
	for (i = 0; i < 504; i++) {
		N5110_WriteByte(*pcBuff++, 1);
	}
}

/* waits (pauses) for ms milliseconds (assumes internal clock at 8MHz) */
void WaitMs(unsigned int ms) {
	int i;

	while (ms-- > 0) {
		/* 8192 (8k) clock cycles for 1ms; each time through loop
		is 5 cycles (for loop control + nop) */
		for (i = 0; i < 1638; ++i)
		asm("nop");
	}
}

// https://sites.google.com/site/qeewiki/books/avr-guide/pwm-on-the-atmega328
void Timer0_Init(void) {
//	OCR0A = 0x01;								// Output Compare Register A (stores the compare value)
	TCCR0A |= (1 << COM0A1);					// None-inverted mode (HIGH at bottom, LOW on Match)
	TCCR0A |= (1 << WGM00);						// PWM, Phase Correct, 8-bit (page 131, 148)
	TCCR0B |= (1 << CS01) | (1 << CS00);        // Bits 2:0 – CS02:0: Clock Select

}